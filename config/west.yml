## config/west.yml
```yaml
manifest:
  remotes:
    - name: zmkfirmware
      url-base: https://github.com/zmkfirmware
  projects:
    - name: zmk
      remote: zmkfirmware
      revision: cd25c12ce99d1ee708d76854a79980c7fb48a331
      import: app/west.yml
  self:
    path: config
```
